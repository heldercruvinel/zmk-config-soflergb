## boards/Kconfig.defconfig
```kconfig
if ZMK_BACKLIGHT

config PWM
    default y

config LED_PWM
    default y

endif # ZMK_BACKLIGHT

if ZMK_RGB_UNDERGLOW

config WS2812_STRIP
    default y
endif

endif
```
